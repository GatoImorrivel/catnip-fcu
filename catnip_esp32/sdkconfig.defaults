## catnip_esp32/sdkconfig.defaults
```kconfig
# Rust often needs a larger main task stack
CONFIG_ESP_MAIN_TASK_STACK_SIZE=16000

# Optional: 1ms FreeRTOS timing
CONFIG_FREERTOS_HZ=1000

# CPU frequency
CONFIG_ESP_DEFAULT_CPU_FREQ_MHZ_240=y

# Optional: more heap debugging
CONFIG_HEAP_POISONING_LIGHT=y
CONFIG_HEAP_TRACING_OFF=y

# Enable Bluetooth
CONFIG_BT_ENABLED=y

# Bluedroid stack (required for esp-idf-svc::bt)
CONFIG_BT_BLUEDROID_ENABLED=y
CONFIG_BT_NIMBLE_ENABLED=n

# BLE-only peripheral mode
CONFIG_BT_CLASSIC_ENABLED=n
CONFIG_BTDM_CTRL_MODE_BLE_ONLY=y
CONFIG_BTDM_CTRL_MODE_BR_EDR_ONLY=n
CONFIG_BTDM_CTRL_MODE_BTDM=n
CONFIG_BT_BLE_42_FEATURES_SUPPORTED=y
CONFIG_BT_BLE_50_FEATURES_SUPPORTED=n
CONFIG_BT_BTC_TASK_STACK_SIZE=15000
CONFIG_BT_BLE_DYNAMIC_ENV_MEMORY=y
```

## catnip_esp32/sdkconfig.defaults.bt
```kconfig
# Enable Bluetooth
CONFIG_BT_ENABLED=y

# Bluedroid stack (required for esp-idf-svc::bt)
CONFIG_BT_BLUEDROID_ENABLED=y
CONFIG_BT_NIMBLE_ENABLED=n

# BLE-only peripheral mode
CONFIG_BT_CLASSIC_ENABLED=n
CONFIG_BTDM_CTRL_MODE_BLE_ONLY=y
CONFIG_BTDM_CTRL_MODE_BR_EDR_ONLY=n
CONFIG_BTDM_CTRL_MODE_BTDM=n
CONFIG_BT_BLE_42_FEATURES_SUPPORTED=y
CONFIG_BT_BLE_50_FEATURES_SUPPORTED=n
CONFIG_BT_BTC_TASK_STACK_SIZE=15000
CONFIG_BT_BLE_DYNAMIC_ENV_MEMORY=y
```

## engines/shoebill-soe/sdkconfig.defaults
```kconfig
# Rust often needs a larger main task stack
CONFIG_ESP_MAIN_TASK_STACK_SIZE=16000

# Optional: 1ms FreeRTOS timing
CONFIG_FREERTOS_HZ=1000

# Target
CONFIG_IDF_TARGET="esp32"

# CPU frequency
CONFIG_ESP_DEFAULT_CPU_FREQ_MHZ_240=y

# Enable Bluetooth
CONFIG_BT_ENABLED=y

# Enable NimBLE (recommended)
CONFIG_BT_NIMBLE_ENABLED=y

# Disable Bluedroid to save memory
CONFIG_BT_BLUEDROID_ENABLED=n

# NimBLE role support
CONFIG_BT_NIMBLE_ROLE_CENTRAL=n
CONFIG_BT_NIMBLE_ROLE_PERIPHERAL=y

# Optional: increase BLE MTU
CONFIG_BT_NIMBLE_ATT_PREFERRED_MTU=256

# Optional: more heap debugging
CONFIG_HEAP_POISONING_LIGHT=y
CONFIG_HEAP_TRACING_OFF=y
```
